/ {
	amba_pl: amba_pl {
		ranges;
		compatible = "simple-bus";
		#address-cells = <2>;
		#size-cells = <2>;
		firmware-name = "codesign_vivado_bd_wrapper.bit.bin";
		afi0: afi0 {
			status = "okay";
			compatible = "xlnx,afi-fpga";
			resets = <&zynqmp_reset 116>, <&zynqmp_reset 117>, <&zynqmp_reset 118>, <&zynqmp_reset 119>;
			config-afi = < 0 0>, <1 0>, <2 0>, <3 0>, <4 0>, <5 0>, <6 0>, <7 0>, <8 0>, <9 0>, <10 0>, <11 0>, <12 0>, <13 0>, <14 0x800>, <15 0x000>;
		};
		axi4_half_adder_1: axi4_half_adder@a0000000 {
			compatible = "xlnx,axi4-half-adder-1.0";
			status = "okay";
			clock-names = "s00_axi_half_adder_aclk";
			xlnx,s00-axi-half-adder-data-width = <32>;
			xlnx,ip-name = "axi4_half_adder";
			xlnx,edk-iptype = "PERIPHERAL";
			xlnx,s00-axi-half-adder-addr-width = <4>;
			reg = <0x0 0xa0000000 0x0 0x10000>;
			clocks = <&zynqmp_clk 71>;
			xlnx,name = "axi4_half_adder_1";
		};
	};
};
